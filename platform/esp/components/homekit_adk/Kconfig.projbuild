## platform/esp/components/homekit_adk/Kconfig.projbuild
```kconfig
menu "HomeKit"

    config HAP_MFI_HW_AUTH
        bool "MFi HW Auth"
        default n
        help
            "Enable to use MFi Authentication Chip"

    menu "MFi I2C"

        config HAP_I2C_SDA_GPIO
            int "SDA GPIO"
            default 26
            help
                GPIO for SDA - please check schematic carefully

        config HAP_I2C_SCL_GPIO
            int "SCL GPIO"
            default 27
            help
                GPIO for SCL - please check schematic carefully

        config HAP_I2C_MAX_READ_COUNT
            int "Max read count"
            range 50 300
            default 150
            help
                Set the max read count

        choice HAP_IC2_SPEED
            prompt "Choose Data Rate"
            default HAP_I2C_DR_400
            help
                I2C Data rate

            config HAP_I2C_DR_400
                bool "400 kbit/s"
            config HAP_I2C_DR_100
                bool "100 kbit/s"
        endchoice

        config HAP_IC2_SPEED
            int
            default 400000 if HAP_I2C_DR_400
            default 100000 if HAP_I2C_DR_100

    endmenu

    config HAP_LOG_LEVEL
        int
        default 0 if LOG_MAXIMUM_LEVEL = 0
        default 1 if LOG_MAXIMUM_LEVEL = 1 || LOG_MAXIMUM_LEVEL = 2
        default 2 if LOG_MAXIMUM_LEVEL = 3
        default 3 if LOG_MAXIMUM_LEVEL = 4 || LOG_MAXIMUM_LEVEL = 5

endmenu
```

## platform/esp/main/Kconfig.projbuild
```kconfig
menu "Application"

    choice LUA_APP_ENTRY
        prompt "Lua Application"
        default LUA_APP_DEFAULT
        help
            Lua Application.

        config LUA_APP_DEFAULT
            bool "default"
        config LUA_APP_EXAMPLE
            bool "example"
        config LUA_APP_TEST
            bool "test"
    endchoice

    config LUA_APP_ENTRY
        string
        default "main" if LUA_APP_DEFAULT
        default "main" if LUA_APP_EXAMPLE
        default "test" if LUA_APP_TEST

endmenu
```
